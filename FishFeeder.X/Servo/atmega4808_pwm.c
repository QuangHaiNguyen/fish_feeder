/*******************************************************************************
* Title                 :   atmega4808_pwm Component   
* Filename              :   atmega4808_pwm.c
* Author                :   Quang Hai Nguyen
* Origin Date           :   20.04.2020
* Version               :   0.0.99
*
*******************************************************************************/

/*************** SOURCE REVISION LOG *****************************************
*
*  Date         Version     Author              Description 
*  20.04.2020   1.0.0       Quang Hai Nguyen    Initial Release.
*
*******************************************************************************/
/** @file  atmega4808_pwm.c
 *  @brief This is the source file for atmega4808_pwm component
 */

/******************************************************************************
* Includes
*******************************************************************************/
#include "atmega4808_pwm.h"

/******************************************************************************
* Module Typedefs
*******************************************************************************/
//None

/******************************************************************************
* Module Variable Definitions
*******************************************************************************/


/******************************************************************************
* Function Definitions
*******************************************************************************/
static void PwmOverflowCallback(void);
/******************************************************************************
* Function : ATMEGA4808_PWM_Init
*//** 
* \b Description:
*
* This function initializes the TCA of the Atmega4808 and uses it as single
* slope PWM generator. The initialization is actually carried out by Microchip 
* Code Configurator (MCC), we only modify minor detail.
*
* PRE-CONDITION: TCA must be generated by MCC or manually implemented  
*
* POST-CONDITION: None
* data
* @param    None
* @return   None
*
* \b Example Example:
* @code
* 	ATMEGA4808_PWM_Init();
* @endcode
*
* @see ATMEGA4808_PWM_Init
*
* <br><b> - HISTORY OF CHANGES - </b>
*  
* <table align="left" style="width:800px">
* <tr><td> Date       </td><td> Software Version </td><td> Initials         </td><td> Description </td></tr>
* <tr><td> 20.04.2020 </td><td> 0.0.99           </td><td> Quang Hai Nguyen </td><td> Interface Created </td></tr>
* </table><br><br>
* <hr>
*
*******************************************************************************/
void ATMEGA4808_PWM_Init(void)
{
    //The actual PWM initialization is done by Microchip Code Configurator
    //We only modify some minor detail
    ATMEGA4808_PWM_Stop();
    TCA0_SetOVFIsrCallback(PwmOverflowCallback);
    TCA0.SINGLE.PERBUF = MAX_TICK;
    
    return;
}


/******************************************************************************
* Function : ATMEGA4808_PWM_Start
*//** 
* \b Description:
*
* This function resets the counter of the timer, the index of the buffer and 
* starts PWM
*
* PRE-CONDITION: ATMEGA4808_PWM_Init and ATMEGA4808_PWM_GetRGBDataInfo must 
* be executed before hand 
*
* POST-CONDITION: None
* 
* @param    None
* @return   None
*
* \b Example Example:
* @code
* 	ATMEGA4808_PWM_Start();
* @endcode
*
* @see ATMEGA4808_PWM_Init
* @see ATMEGA4808_PWM_GetRGBDataInfo 
*
* <br><b> - HISTORY OF CHANGES - </b>
*  
* <table align="left" style="width:800px">
* <tr><td> Date       </td><td> Software Version </td><td> Initials         </td><td> Description </td></tr>
* <tr><td> 20.04.2020 </td><td> 0.0.99           </td><td> Quang Hai Nguyen </td><td> Interface Created </td></tr>
* </table><br><br>
* <hr>
*
*******************************************************************************/
void ATMEGA4808_PWM_Start(void)
{   
    //Reset timer counter
    TCA0.SINGLE.CNT = 0;
    
    //Start PWM
    TCA0.SINGLE.CTRLA |= (1 << TCA_SINGLE_ENABLE_bp);
}

/******************************************************************************
* Function : ATMEGA4808_PWM_Stop
*//** 
* \b Description:
*
* This function stops the PWM 
*
* PRE-CONDITION: ATMEGA4808_PWM_Init must be executed before hand
*
* POST-CONDITION: None
* data
* @param    None
* @return   None
*
* \b Example Example:
* @code
* 	ATMEGA4808_PWM_Stop();
* @endcode
*
* @see ATMEGA4808_PWM_Init
*
* <br><b> - HISTORY OF CHANGES - </b>
*  
* <table align="left" style="width:800px">
* <tr><td> Date       </td><td> Software Version </td><td> Initials         </td><td> Description </td></tr>
* <tr><td> 20.04.2020 </td><td> 0.0.99           </td><td> Quang Hai Nguyen </td><td> Interface Created </td></tr>
* </table><br><br>
* <hr>
*
*******************************************************************************/
void ATMEGA4808_PWM_Stop(void)
{
    //Stop PWM
    TCA0.SINGLE.CTRLA &= ~(1 << TCA_SINGLE_ENABLE_bp);
}

/******************************************************************************
* Function : ATMEGA4808_PWM_DeInit
*//** 
* \b Description:
*
* This function de-reference the pointer, reset index, cleanup stuffs
*
* PRE-CONDITION: ATMEGA4808_PWM_Init must be executed before hand  
*
* POST-CONDITION: None
* data
* @param    None
* @return   None
*
* \b Example Example:
* @code
* 	ATMEGA4808_PWM_Stop();
* @endcode
*
* @see ATMEGA4808_PWM_Init
*
* <br><b> - HISTORY OF CHANGES - </b>
*  
* <table align="left" style="width:800px">
* <tr><td> Date       </td><td> Software Version </td><td> Initials         </td><td> Description </td></tr>
* <tr><td> 20.04.2020 </td><td> 0.0.99           </td><td> Quang Hai Nguyen </td><td> Interface Created </td></tr>
* </table><br><br>
* <hr>
*
*******************************************************************************/
void ATMEGA4808_PWM_DeInit(void)
{
    ATMEGA4808_PWM_Stop();
}

void ATMEGA4808_PWM_SetDutyCycle(uint32_t u16PeriodInNanoSec)
{
    if(NANOSEC_TO_TICK(u16PeriodInNanoSec) <= MAX_TICK)
    {
        TCA0.SINGLE.CMP0BUF = NANOSEC_TO_TICK(u16PeriodInNanoSec);
    }
    else
    {
        TCA0.SINGLE.CMP0BUF = 0;
    }
}

void ATMEGA4808_PWM_SetPeriod(uint32_t u16PeriodInNanoSec)
{
    if(NANOSEC_TO_TICK(u16PeriodInNanoSec) <= MAX_TICK)
    {
        TCA0.SINGLE.PERBUF = NANOSEC_TO_TICK(u16PeriodInNanoSec);
    }
    else
    {
        TCA0.SINGLE.PERBUF = MAX_TICK;
    }
}

/******************************************************************************
* Function : TCA0_OVF_vect
*//** 
* \b Description:
*
* Interrupt service routine to handle capture and compare interrupt. After each 
* match, we load the new value from the buffer to the Capture and compare 
* register
*
* PRE-CONDITION: ATMEGA4808_PWM_Init and ATMEGA4808_PWM_GetRGBDataInfo
* must be executed before hand  
*
* POST-CONDITION: None
* data
* @param    None
* @return   None
*
* <br><b> - HISTORY OF CHANGES - </b>
*  
* <table align="left" style="width:800px">
* <tr><td> Date       </td><td> Software Version </td><td> Initials         </td><td> Description </td></tr>
* <tr><td> 20.04.2020 </td><td> 0.0.99           </td><td> Quang Hai Nguyen </td><td> Interface Created </td></tr>
* </table><br><br>
* <hr>
*
*******************************************************************************/
#if 0
ISR(TCA0_OVF_vect)
{
#if 0
    //If we have done with the bufferm stop the PWM
    if(++RGB_buff_index > RGB_buff_size)
    {
        ATMEGA4808_PWM_Stop();
    } 
    TCA0.SINGLE.CMP0BUF = pointer_to_RGB_buff[RGB_buff_index];   
#endif
    //"Clear" interrupt flag
    TCA0.SINGLE.INTFLAGS = TCA_SINGLE_OVF_bm;
}
#endif

static void PwmOverflowCallback(void)
{
    TCA0_ClearOverflowInterruptFlag();
}
/*** End of File **************************************************************/